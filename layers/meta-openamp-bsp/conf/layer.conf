## layers/meta-openamp-bsp/conf/layer.conf
```bitbake
# We have a conf and classes directory, add to BBPATH
BBPATH .= ":${LAYERDIR}"

# We have recipes-* directories, add to BBFILES
BBFILES += "${LAYERDIR}/recipes-*/*/*.bb \
            ${LAYERDIR}/recipes-*/*/*.bbappend"

BBFILE_COLLECTIONS += "openampbsp"
BBFILE_PATTERN_openampbsp = "^${LAYERDIR}/"
BBFILE_PRIORITY_openampbsp = "5"
LAYERVERSION_openampbsp = "4"

# meta-openamp upstream master branch supports:
# = POLICY ======== CURRENT RELEASE ===
# master            styhead     YP 5.1 2024/10
# current release   (same as LTS)
# LTS               scarthgap   YP 5.0 2024/04
# LTS-1             kirkstone   YP 4.0 2022/04
#
# Supported for transition debug only
# previous release  nanbield    YP 4.3 2023/10

LAYERSERIES_COMPAT_openampbsp = "styhead scarthgap kirkstone nanbield"
```

## layers/meta-openamp-bsp/conf/machine/generic-armv7a.conf
```bitbake
#@TYPE: Machine
#@NAME: Generic Arm V7a (with hard float ABI)
#@DESCRIPTION: Machine configuration for building OS that will run on many ARMv7 systems

require conf/machine/include/arm/arch-armv7a.inc
#require conf/machine/include/qemu.inc


PREFERRED_PROVIDER_virtual/kernel ?= "linux-yocto"
KBUILD_DEFCONFIG = "multi_v7_defconfig"
KCONFIG_MODE = "--alldefconfig"
KERNEL_IMAGETYPE = "zImage"
MACHINE_EXTRA_RRECOMMENDS += "kernel-modules"

#UBOOT_MACHINE ?= "qemu_arm_defconfig"

SERIAL_CONSOLES ?= "115200;ttyS0 115200;ttyAMA0 115200;hvc0 115200;ttySTM0"
SERIAL_CONSOLES_CHECK = "${SERIAL_CONSOLES}"

# For runqemu
QB_SYSTEM_NAME = "qemu-system-arm"
QB_MACHINE = "-machine virt,highmem=off"
QB_CPU = "-cpu cortex-a8"
QB_SMP = "-smp 4"
# Standard Serial console
QB_KERNEL_CMDLINE_APPEND = "vmalloc=256"
# For graphics to work we need to define the VGA device as well as the necessary USB devices
QB_GRAPHICS = "-device virtio-gpu-pci"
QB_OPT_APPEND = "-device qemu-xhci -device usb-tablet -device usb-kbd"
# Virtio Networking support
QB_TAP_OPT = "-netdev tap,id=net0,ifname=@TAP@,script=no,downscript=no"
QB_NETWORK_DEVICE = "-device virtio-net-device,netdev=net0,mac=@MAC@"
# Virtio block device
QB_ROOTFS_OPT = "-drive id=disk0,file=@ROOTFS@,if=none,format=raw -device virtio-blk-device,drive=disk0"
# Virtio serial console
QB_SERIAL_OPT = "-device virtio-serial-device -chardev null,id=virtcon -device virtconsole,chardev=virtcon"
QB_TCPSERIAL_OPT = "-device virtio-serial-device -chardev socket,id=virtcon,port=@PORT@,host=127.0.0.1 -device virtconsole,chardev=virtcon"

KMACHINE:generic-armv7a = "generic-armv7a"
```
